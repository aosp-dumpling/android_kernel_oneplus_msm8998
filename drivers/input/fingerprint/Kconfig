## drivers/input/fingerprint/Kconfig
```kconfig
#
# Configuration for FPC
#

menuconfig INPUT_FINGERPRINT
	bool "Fingerprints"
	help
	  Say Y here, and a list of supported fingerprints will be displayed.

if INPUT_FINGERPRINT

config INPUT_GOODIX
	tristate "Goodix fingerprint sensor Driver"
	depends on SPI_MASTER
	default n
	help
	  This is a Goodix fingerprint sensor Driver.

endif
```

## drivers/input/misc/tri_state_key/Kconfig
```kconfig
config INPUT_TRI_STATE_KEY
   tristate "Tri-state-key switch support"
   default n
   help
    Say Y here if you want to switch Profiles by this triple key.
```

## drivers/nfc/pn5xx/Kconfig
```kconfig
#
# Near Field Communication (NFC) devices
#

config NFC_PN5XX
	tristate "NXP PN5XX NFC Driver"
	depends on I2C
	default n
	help
	  Say Y here to compile the NFC driver for NXP PN5XX NFC based devices.
```

## drivers/oneplus/Kconfig
```kconfig
source "drivers/oneplus/coretech/Kconfig"
source "drivers/oneplus/coretech/Kconfig"
```

## drivers/platform/oneplus/Kconfig
```kconfig
menu "OnePlus specific device drivers"
	depends on ARCH_QCOM

config BOARD_DUMPLING
	bool "Dumpling device support"
	depends on ARCH_MSM8998
	help
	  Say 'y' here to include Dumpling only modifications

endmenu
```
